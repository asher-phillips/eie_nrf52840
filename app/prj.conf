## CMakeLists.txt
```
#-------------------------------------------------------------------------------
# Zephyr Example Application
#
# Copyright (c) 2021 Nordic Semiconductor ASA
# SPDX-License-Identifier: Apache-2.0

cmake_minimum_required(VERSION 3.13.1)
find_package(Zephyr REQUIRED HINTS $ENV{ZEPHYR_BASE})

project(app LANGUAGES C)

zephyr_include_directories(src)

target_sources(app PRIVATE src/main.c)

target_sources(app PRIVATE src/UploadtoScreen.c)

#Runes
target_sources(app PRIVATE src/BlueRune.c)
target_sources(app PRIVATE src/GreenRune.c)
target_sources(app PRIVATE src/PurpleRune.c)
target_sources(app PRIVATE src/RedRune.c)

#Hearts
target_sources(app PRIVATE src/HeartRune.c)
target_sources(app PRIVATE src/GreyHeartRune.c)
target_sources(app PRIVATE src/ThreeHeartsRune.c)
target_sources(app PRIVATE src/TwoHeartsRune.c)
target_sources(app PRIVATE src/OneHeartRune.c)
target_sources(app PRIVATE src/ZeroHeartRune.c)

#Title
target_sources(app PRIVATE src/RuneTitle.c)

target_sources(app PRIVATE src/game_sm.c)

#End card
target_sources(app PRIVATE src/GameOverRune)
target_sources(app PRIVATE src/HighScoreRune)
target_sources(app PRIVATE src/ScoreRune)
```

## prj.conf
```kconfig
# Copyright (c) 2021 Nordic Semiconductor ASA
# SPDX-License-Identifier: Apache-2.0
#
# This file contains selected Kconfig options for the application.

CONFIG_GPIO=y
CONFIG_PWM=y
CONFIG_SMF=y

CONFIG_DISPLAY=y
CONFIG_LVGL=y
CONFIG_TEST_RANDOM_GENERATOR=y

CONFIG_LV_Z_MEM_POOL_SIZE=16384
CONFIG_MAIN_STACK_SIZE=4096
```

## src/main.c
```c
/**
 * @file main.c
 */

#include <inttypes.h>

#include <zephyr/kernel.h>
#include <zephyr/sys/printk.h>
#include <zephyr/device.h>
#include <zephyr/drivers/display.h>

#include <lvgl.h>

#include "BTN.h"
#include "LED.h"
#include "lv_data_obj.h"

#include "game_sm.h"

#define SLEEP_MS 10

static const struct device *display_dev = DEVICE_DT_GET(DT_CHOSEN(zephyr_display));


int main(void) {
    if (!device_is_ready(display_dev)) {
        return 0;
    }

    if (0 > BTN_init()) {
        return 0;
    }
    if (0 > LED_init()) {
        return 0;
    }

    game_sm_init();
    display_blanking_off(display_dev);
    
    while(1) {
        game_sm_run();
        lv_timer_handler();
        k_msleep(SLEEP_MS);
    }
    return 0;
}
```

## src/GreyHeartRune.c
```c
#ifdef __has_include
    #if __has_include("lvgl.h")
        #ifndef LV_LVGL_H_INCLUDE_SIMPLE
            #define LV_LVGL_H_INCLUDE_SIMPLE
        #endif
    #endif
#endif

#if defined(LV_LVGL_H_INCLUDE_SIMPLE)
    #include "lvgl.h"
#else
    #include "lvgl/lvgl.h"
#endif


#ifndef LV_ATTRIBUTE_MEM_ALIGN
#define LV_ATTRIBUTE_MEM_ALIGN
#endif

#ifndef LV_ATTRIBUTE_IMAGE_GREYHEARTRUNE
#define LV_ATTRIBUTE_IMAGE_GREYHEARTRUNE
#endif

const LV_ATTRIBUTE_MEM_ALIGN LV_ATTRIBUTE_LARGE_CONST LV_ATTRIBUTE_IMAGE_GREYHEARTRUNE uint8_t GreyHeartRune_map[] = {
  0xfb, 0xfb, 0xfb, 0xff, 0xff, 0xff, 0xfe, 0xff, 0xff, 0xff, 0xff, 0xff, 0xfe, 0xfe, 0xfe, 0xfd, 0xfd, 0xfd, 0xfe, 0xfe, 0xfe, 0xff, 0xff, 0xff, 0xff, 0xff, 0xff, 0xff, 0xff, 0xff, 0xfb, 0xfb, 0xfb, 0xfc, 0xfc, 0xfc, 0xff, 0xff, 0xff, 0xff, 0xff, 0xff, 0xff, 0xff, 0xff, 0xfe, 0xfe, 0xfe, 0xf9, 0xf9, 0xf9, 0xff, 0xff, 0xff, 0xff, 0xff, 0xff, 0xff, 0xff, 0xff, 0xff, 0xff, 0xff, 0xff, 0xff, 0xff, 0xfd, 0xfd, 0xfd, 0xfa, 0xfb, 0xfb, 0xff, 0xff, 0xff, 0xfe, 0xfe, 0xfe, 0xfd, 0xfc, 0xfc, 0xff, 0xff, 0xfe, 0xff, 0xff, 0xff, 0xfe, 0xfe, 0xfe, 
  0xff, 0xff, 0xff, 0xfb, 0xfb, 0xfb, 0xfa, 0xfa, 0xfa, 0xfe, 0xfe, 0xff, 0xff, 0xff, 0xff, 0xff, 0xff, 0xff, 0xff, 0xff, 0xff, 0xff, 0xff, 0xff, 0xf6, 0xf6, 0xf6, 0xff, 0xff, 0xff, 0xff, 0xfe, 0xff, 0xfe, 0xff, 0xff, 0xf8, 0xf8, 0xf8, 0xf3, 0xf2, 0xf3, 0xf8, 0xf8, 0xf8, 0xff, 0xff, 0xff, 0xff, 0xff, 0xff, 0xff, 0xfe, 0xfe, 0xf8, 0xf8, 0xf8, 0xfa, 0xfa, 0xfa, 0xfb, 0xfb, 0xfb, 0xfb, 0xfb, 0xfb, 0xff, 0xff, 0xff, 0xff, 0xff, 0xff, 0xff, 0xff, 0xff, 0xff, 0xff, 0xff, 0xff, 0xff, 0xff, 0xfe, 0xfe, 0xfe, 0xfe, 0xfe, 0xfe, 0xfe, 0xfe, 0xfe, 
  0xff, 0xff, 0xff, 0xfc, 0xfd, 0xfc, 0xfc, 0xfc, 0xfc, 0xff, 0xff, 0xff, 0xff, 0xff, 0xff, 0xfe, 0xfe, 0xfe, 0xfb, 0xfb, 0xfb, 0xfe, 0xfe, 0xfe, 0xff, 0xff, 0xff, 0xff, 0xff, 0xff, 0xf9, 0xf9, 0xf9, 0xf9, 0xf9, 0xf9, 0xff, 0xff, 0xff, 0xff, 0xfe, 0xff, 0xff, 0xff, 0xff, 0xff, 0xff, 0xff, 0xfb, 0xfa, 0xfb, 0xfa, 0xfa, 0xfa, 0xfc, 0xfc, 0xfc, 0xff, 0xff, 0xff, 0xff, 0xff, 0xff, 0xff, 0xff, 0xff, 0xfc, 0xfc, 0xfc, 0xf6, 0xf7, 0xf7, 0xfd, 0xfd, 0xfd, 0xfd, 0xfc, 0xfd, 0xff, 0xff, 0xff, 0xff, 0xff, 0xfe, 0xfb, 0xfb, 0xfb, 0xff, 0xff, 0xff, 
  0xff, 0xff, 0xfe, 0xff, 0xff, 0xff, 0xfe, 0xff, 0xff, 0xff, 0xff, 0xff, 0xff, 0xff, 0xff, 0xfe, 0xff, 0xff, 0xff, 0xff, 0xff, 0xff, 0xfe, 0xff, 0xf7, 0xf7, 0xf7, 0xfd, 0xfd, 0xfd, 0xff, 0xfe, 0xff, 0xff, 0xff, 0xff, 0xff, 0xff, 0xfe, 0xff, 0xff, 0xff, 0xfd, 0xfc, 0xfc, 0xfb, 0xfb, 0xfb, 0xfe, 0xfe, 0xfe, 0xfe, 0xff, 0xff, 0xff, 0xff, 0xff, 0xfc, 0xfc, 0xfc, 0xfc, 0xfd, 0xfd, 0xff, 0xff, 0xfe, 0xff, 0xff, 0xff, 0xfe, 0xfe, 0xfe, 0xfd, 0xfd, 0xfd, 0xf8, 0xf9, 0xf8, 0xfe, 0xfe, 0xfe, 0xff, 0xff, 0xff, 0xfe, 0xfe, 0xfe, 0xfe, 0xff, 0xff, 
  0xff, 0xff, 0xff, 0xff, 0xff, 0xff, 0xfc, 0xfc, 0xfc, 0xf8, 0xf8, 0xf8, 0xfe, 0xff, 0xfe, 0xff, 0xff, 0xff, 0xff, 0xff, 0xff, 0xf3, 0xf3, 0xf3, 0xdc, 0xdc, 0xdc, 0xc8, 0xc8, 0xc8, 0xba, 0xbb, 0xba, 0xc5, 0xc5, 0xc5, 0xe4, 0xe4, 0xe4, 0xff, 0xff, 0xff, 0xff, 0xff, 0xff, 0xff, 0xff, 0xff, 0xf6, 0xf6, 0xf6, 0xe7, 0xe7, 0xe7, 0xd2, 0xd2, 0xd2, 0xc0, 0xc0, 0xc0, 0xbf, 0xbf, 0xbf, 0xd2, 0xd2, 0xd2, 0xf0, 0xf0, 0xf0, 0xff, 0xff, 0xff, 0xff, 0xff, 0xff, 0xfc, 0xfc, 0xfc, 0xfc, 0xfc, 0xfc, 0xff, 0xff, 0xff, 0xff, 0xff, 0xff, 0xfd, 0xfd, 0xfd, 
  0xff, 0xff, 0xff, 0xfe, 0xfe, 0xfe, 0xfc, 0xfd, 0xfd, 0xff, 0xff, 0xff, 0xff, 0xff, 0xff, 0xff, 0xfe, 0xfe, 0xd9, 0xd9, 0xd8, 0xb5, 0xb5, 0xb5, 0x9a, 0x9a, 0x9a, 0x9b, 0x9b, 0x9b, 0x99, 0x99, 0x99, 0x95, 0x95, 0x95, 0x9a, 0x9a, 0x9b, 0xb5, 0xb5, 0xb5, 0xdf, 0xdf, 0xdf, 0xff, 0xff, 0xff, 0xbb, 0xbb, 0xbb, 0xa1, 0xa0, 0xa0, 0x91, 0x91, 0x91, 0x96, 0x96, 0x96, 0x94, 0x94, 0x94, 0x93, 0x93, 0x93, 0xaf, 0xaf, 0xaf, 0xd7, 0xd7, 0xd7, 0xfe, 0xfe, 0xfe, 0xff, 0xfe, 0xff, 0xfe, 0xfe, 0xfe, 0xfd, 0xfd, 0xfc, 0xff, 0xfe, 0xff, 0xfb, 0xfb, 0xfb, 
  0xff, 0xff, 0xff, 0xfc, 0xfc, 0xfc, 0xfe, 0xff, 0xff, 0xff, 0xff, 0xff, 0xfd, 0xfc, 0xfd, 0xd4, 0xd4, 0xd4, 0xa6, 0xa6, 0xa6, 0x8b, 0x8b, 0x8b, 0x93, 0x93, 0x93, 0x93, 0x93, 0x93, 0x94, 0x95, 0x94, 0x97, 0x97, 0x97, 0x9a, 0x9a, 0x9b, 0x9c, 0x9c, 0x9c, 0x9b, 0x9b, 0x9b, 0x9a, 0x9a, 0x9a, 0x92, 0x92, 0x92, 0x88, 0x89, 0x89, 0x8d, 0x8d, 0x8d, 0x9c, 0x9c, 0x9c, 0x9a, 0x9a, 0x9a, 0x8e, 0x8e, 0x8e, 0x92, 0x92, 0x92, 0xa4, 0xa4, 0xa4, 0xd4, 0xd4, 0xd5, 0xfd, 0xfd, 0xfd, 0xff, 0xff, 0xff, 0xf8, 0xf8, 0xf8, 0xff, 0xff, 0xff, 0xff, 0xff, 0xff, 
  0xff, 0xff, 0xff, 0xfb, 0xfb, 0xfb, 0xfc, 0xfc, 0xfc, 0xfb, 0xfb, 0xfb, 0xd8, 0xd9, 0xd8, 0xa5, 0xa5, 0xa5, 0x91, 0x91, 0x91, 0x9a, 0x9a, 0x9a, 0x98, 0x98, 0x98, 0x97, 0x97, 0x97, 0x95, 0x95, 0x95, 0x95, 0x95, 0x95, 0x96, 0x96, 0x96, 0x97, 0x97, 0x97, 0x96, 0x97, 0x97, 0x97, 0x97, 0x97, 0x94, 0x94, 0x94, 0x9b, 0x9b, 0x9b, 0x9a, 0x9a, 0x9a, 0x92, 0x92, 0x92, 0x91, 0x91, 0x91, 0x97, 0x97, 0x97, 0x98, 0x98, 0x98, 0x92, 0x92, 0x92, 0xa7, 0xa7, 0xa6, 0xf1, 0xf1, 0xf1, 0xff, 0xff, 0xff, 0xf7, 0xf7, 0xf7, 0xff, 0xfe, 0xff, 0xff, 0xff, 0xff, 
  0xff, 0xff, 0xff, 0xfa, 0xfa, 0xfa, 0xff, 0xff, 0xff, 0xee, 0xee, 0xee, 0xa1, 0xa1, 0xa1, 0x9c, 0x9c, 0x9c, 0x9a, 0x9a, 0x9b, 0x91, 0x90, 0x91, 0x96, 0x96, 0x96, 0x96, 0x96, 0x96, 0x96, 0x96, 0x96, 0x96, 0x96, 0x96, 0x96, 0x96, 0x96, 0x96, 0x96, 0x96, 0x97, 0x96, 0x96, 0x96, 0x96, 0x96, 0x96, 0x96, 0x96, 0x96, 0x96, 0x96, 0x96, 0x96, 0x97, 0x96, 0x96, 0x96, 0x96, 0x96, 0x96, 0x96, 0x96, 0x96, 0x96, 0x96, 0x96, 0x96, 0x96, 0x96, 0x98, 0x98, 0x98, 0xb4, 0xb4, 0xb4, 0xff, 0xff, 0xff, 0xfd, 0xfd, 0xfd, 0xff, 0xff, 0xff, 0xff, 0xff, 0xff, 
  0xff, 0xff, 0xff, 0xfe, 0xff, 0xfe, 0xff, 0xff, 0xff, 0xcd, 0xcd, 0xcd, 0x9a, 0x9a, 0x9a, 0x91, 0x91, 0x91, 0x92, 0x92, 0x92, 0x9a, 0x9a, 0x9a, 0x96, 0x96, 0x96, 0x96, 0x96, 0x96, 0x96, 0x96, 0x96, 0x96, 0x96, 0x96, 0x96, 0x96, 0x96, 0x96, 0x96, 0x96, 0x96, 0x96, 0x96, 0x96, 0x96, 0x96, 0x96, 0x96, 0x96, 0x96, 0x96, 0x96, 0x96, 0x96, 0x97, 0x96, 0x96, 0x96, 0x96, 0x96, 0x96, 0x96, 0x96, 0x96, 0x96, 0x96, 0x96, 0x96, 0x96, 0x96, 0x91, 0x91, 0x91, 0xa2, 0xa2, 0xa2, 0xf3, 0xf3, 0xf3, 0xff, 0xff, 0xff, 0xff, 0xfe, 0xff, 0xfc, 0xfc, 0xfc, 
  0xff, 0xff, 0xff, 0xff, 0xff, 0xff, 0xff, 0xff, 0xff, 0xb1, 0xb1, 0xb1, 0x98, 0x99, 0x98, 0x93, 0x93, 0x93, 0x90, 0x90, 0x90, 0x9e, 0x9f, 0x9e, 0x96, 0x96, 0x96, 0x96, 0x96, 0x96, 0x96, 0x96, 0x96, 0x96, 0x96, 0x96, 0x96, 0x96, 0x97, 0x96, 0x96, 0x96, 0x97, 0x96, 0x96, 0x96, 0x96, 0x96, 0x96, 0x97, 0x96, 0x97, 0x96, 0x96, 0x96, 0x96, 0x96, 0x96, 0x96, 0x96, 0x96, 0x96, 0x96, 0x96, 0x96, 0x96, 0x96, 0x97, 0x96, 0x96, 0x96, 0x96, 0x95, 0x95, 0x94, 0x91, 0x90, 0x91, 0xdb, 0xdb, 0xdb, 0xff, 0xff, 0xff, 0xff, 0xfe, 0xff, 0xfa, 0xfa, 0xfa, 
  0xff, 0xff, 0xfe, 0xfa, 0xfa, 0xfa, 0xff, 0xff, 0xff, 0xb5, 0xb5, 0xb5, 0x97, 0x97, 0x97, 0x9f, 0x9f, 0x9f, 0x94, 0x94, 0x95, 0x98, 0x98, 0x98, 0x97, 0x96, 0x96, 0x96, 0x96, 0x96, 0x96, 0x97, 0x96, 0x96, 0x96, 0x96, 0x96, 0x96, 0x97, 0x96, 0x96, 0x96, 0x97, 0x96, 0x96, 0x96, 0x96, 0x96, 0x96, 0x96, 0x96, 0x96, 0x96, 0x96, 0x96, 0x96, 0x96, 0x96, 0x96, 0x96, 0x96, 0x96, 0x96, 0x96, 0x96, 0x97, 0x96, 0x96, 0x96, 0x96, 0x96, 0x96, 0x9b, 0x9b, 0x9b, 0x90, 0x90, 0x90, 0xcd, 0xcd, 0xcd, 0xfc, 0xfc, 0xfc, 0xff, 0xff, 0xff, 0xff, 0xff, 0xff, 
  0xff, 0xff, 0xfe, 0xf9, 0xf9, 0xf9, 0xfe, 0xff, 0xff, 0xd2, 0xd2, 0xd3, 0x8e, 0x8e, 0x8e, 0x9c, 0x9c, 0x9c, 0x96, 0x96, 0x96, 0x93, 0x93, 0x93, 0x97, 0x96, 0x96, 0x96, 0x96, 0x97, 0x96, 0x96, 0x96, 0x96, 0x96, 0x96, 0x96, 0x96, 0x96, 0x96, 0x96, 0x96, 0x97, 0x96, 0x96, 0x96, 0x96, 0x96, 0x96, 0x96, 0x96, 0x96, 0x96, 0x96, 0x96, 0x96, 0x96, 0x96, 0x96, 0x96, 0x96, 0x96, 0x96, 0x96, 0x96, 0x96, 0x96, 0x96, 0x96, 0x97, 0x96, 0x96, 0x91, 0x91, 0x91, 0xa0, 0xa0, 0xa0, 0xd6, 0xd7, 0xd7, 0xff, 0xff, 0xff, 0xfd, 0xfd, 0xfd, 0xfe, 0xff, 0xff, 
  0xff, 0xff, 0xff, 0xfc, 0xfc, 0xfc, 0xff, 0xff, 0xff, 0xee, 0xee, 0xee, 0x95, 0x95, 0x95, 0x91, 0x90, 0x90, 0x95, 0x95, 0x95, 0x94, 0x94, 0x94, 0x97, 0x96, 0x96, 0x96, 0x96, 0x96, 0x96, 0x97, 0x96, 0x97, 0x96, 0x96, 0x96, 0x96, 0x97, 0x96, 0x96, 0x96, 0x96, 0x96, 0x96, 0x96, 0x96, 0x96, 0x96, 0x96, 0x96, 0x97, 0x96, 0x96, 0x96, 0x96, 0x96, 0x96, 0x97, 0x96, 0x96, 0x96, 0x96, 0x96, 0x96, 0x96, 0x96, 0x96, 0x96, 0x97, 0x96, 0x96, 0x8d, 0x8d, 0x8d, 0xbe, 0xbe, 0xbe, 0xee, 0xef, 0xef, 0xff, 0xff, 0xff, 0xfa, 0xfa, 0xfa, 0xfe, 0xfe, 0xfe, 
  0xff, 0xff, 0xff, 0xff, 0xff, 0xff, 0xff, 0xff, 0xff, 0xfe, 0xfe, 0xfe, 0xc5, 0xc4, 0xc5, 0x9a, 0x9a, 0x9a, 0x9a, 0x9a, 0x9b, 0x93, 0x93, 0x93, 0x96, 0x96, 0x96, 0x96, 0x96, 0x96, 0x96, 0x96, 0x96, 0x96, 0x96, 0x96, 0x96, 0x96, 0x96, 0x96, 0x96, 0x96, 0x96, 0x96, 0x96, 0x96, 0x96, 0x96, 0x96, 0x97, 0x96, 0x96, 0x96, 0x96, 0x96, 0x96, 0x97, 0x96, 0x96, 0x96, 0x96, 0x96, 0x96, 0x96, 0x96, 0x96, 0x96, 0x96, 0x96, 0x96, 0x96, 0x96, 0xb1, 0xb1, 0xb1, 0xe8, 0xe8, 0xe8, 0xfd, 0xfd, 0xfd, 0xff, 0xff, 0xff, 0xfb, 0xfb, 0xfb, 0xff, 0xff, 0xff, 
  0xff, 0xff, 0xff, 0xff, 0xff, 0xff, 0xfb, 0xfa, 0xfa, 0xff, 0xff, 0xfe, 0xfb, 0xfb, 0xfb, 0xb2, 0xb2, 0xb2, 0xa3, 0xa3, 0xa3, 0x8f, 0x8f, 0x8f, 0x96, 0x96, 0x96, 0x96, 0x96, 0x96, 0x96, 0x96, 0x96, 0x96, 0x96, 0x96, 0x96, 0x96, 0x96, 0x96, 0x97, 0x96, 0x96, 0x96, 0x96, 0x96, 0x96, 0x96, 0x96, 0x96, 0x96, 0x96, 0x96, 0x96, 0x96, 0x96, 0x96, 0x96, 0x96, 0x96, 0x96, 0x96, 0x96, 0x96, 0x96, 0x96, 0x96, 0x96, 0x96, 0x96, 0x96, 0x96, 0xe2, 0xe2, 0xe2, 0xff, 0xff, 0xff, 0xfc, 0xfc, 0xfc, 0xfc, 0xfc, 0xfc, 0xfe, 0xfe, 0xfe, 0xff, 0xff, 0xff, 
  0xfb, 0xfb, 0xfa, 0xff, 0xff, 0xff, 0xfe, 0xfe, 0xfe, 0xfa, 0xfa, 0xfa, 0xff, 0xff, 0xff, 0xf8, 0xf8, 0xf8, 0xc6, 0xc6, 0xc6, 0x8d, 0x8d, 0x8d, 0x9c, 0x9c, 0x9c, 0x8d, 0x8d, 0x8d, 0x91, 0x91, 0x91, 0x9a, 0x9a, 0x9a, 0x95, 0x95, 0x95, 0x99, 0x99, 0x99, 0x9e, 0x9e, 0x9e, 0x94, 0x94, 0x94, 0x97, 0x96, 0x97, 0x94, 0x94, 0x94, 0x9b, 0x9b, 0x9b, 0x94, 0x95, 0x94, 0x95, 0x94, 0x94, 0x90, 0x90, 0x90, 0x9e, 0x9e, 0x9e, 0xe4, 0xe5, 0xe5, 0xff, 0xff, 0xff, 0xff, 0xff, 0xff, 0xfe, 0xff, 0xff, 0xff, 0xff, 0xfe, 0xff, 0xff, 0xff, 0xff, 0xff, 0xff, 
  0xff, 0xff, 0xff, 0xff, 0xff, 0xff, 0xfe, 0xff, 0xff, 0xfc, 0xfc, 0xfc, 0xff, 0xff, 0xff, 0xff, 0xff, 0xff, 0xea, 0xea, 0xea, 0xc8, 0xc8, 0xc8, 0x8b, 0x8b, 0x8b, 0xa1, 0xa1, 0xa1, 0x98, 0x98, 0x98, 0x8d, 0x8d, 0x8d, 0x9a, 0x9a, 0x9a, 0x96, 0x96, 0x96, 0x8c, 0x8c, 0x8c, 0x9a, 0x9a, 0x9a, 0x95, 0x95, 0x95, 0x99, 0x99, 0x99, 0x92, 0x92, 0x92, 0xa5, 0xa5, 0xa5, 0x92, 0x93, 0x93, 0x96, 0x96, 0x96, 0xe1, 0xe1, 0xe1, 0xf6, 0xf6, 0xf6, 0xff, 0xff, 0xff, 0xff, 0xff, 0xff, 0xff, 0xff, 0xff, 0xff, 0xff, 0xff, 0xff, 0xff, 0xff, 0xff, 0xff, 0xff, 
  0xff, 0xff, 0xff, 0xff, 0xff, 0xff, 0xff, 0xfe, 0xfe, 0xfc, 0xfc, 0xfd, 0xff, 0xff, 0xff, 0xff, 0xff, 0xff, 0xff, 0xff, 0xff, 0xf8, 0xf8, 0xf8, 0xba, 0xba, 0xba, 0x9b, 0x9b, 0x9b, 0x8f, 0x8f, 0x8f, 0x9b, 0x9a, 0x9a, 0x99, 0x99, 0x99, 0x8d, 0x8d, 0x8d, 0x8f, 0x8f, 0x8f, 0x9a, 0x9a, 0x9a, 0x98, 0x98, 0x98, 0x90, 0x90, 0x90, 0x9b, 0x9b, 0x9b, 0x95, 0x95, 0x95, 0x99, 0x99, 0x99, 0xcd, 0xcd, 0xcd, 0xfb, 0xfb, 0xfb, 0xfe, 0xff, 0xff, 0xff, 0xff, 0xff, 0xff, 0xfe, 0xff, 0xff, 0xff, 0xff, 0xff, 0xff, 0xfe, 0xff, 0xff, 0xff, 0xff, 0xff, 0xff, 
  0xfe, 0xfe, 0xfe, 0xfd, 0xfd, 0xfd, 0xfe, 0xfe, 0xfe, 0xff, 0xff, 0xff, 0xff, 0xff, 0xff, 0xfe, 0xfe, 0xfe, 0xff, 0xff, 0xff, 0xff, 0xff, 0xff, 0xfa, 0xfa, 0xfa, 0xb7, 0xb7, 0xb7, 0x94, 0x94, 0x94, 0x96, 0x97, 0x97, 0x93, 0x93, 0x93, 0x95, 0x95, 0x95, 0x9c, 0x9c, 0x9c, 0x93, 0x93, 0x93, 0x97, 0x97, 0x97, 0x98, 0x98, 0x98, 0x99, 0x99, 0x99, 0x8b, 0x8b, 0x8b, 0xc2, 0xc3, 0xc3, 0xff, 0xff, 0xfe, 0xf8, 0xf8, 0xf8, 0xff, 0xff, 0xff, 0xff, 0xff, 0xff, 0xff, 0xff, 0xff, 0xff, 0xff, 0xff, 0xff, 0xff, 0xff, 0xff, 0xff, 0xff, 0xff, 0xff, 0xff, 
  0xff, 0xff, 0xff, 0xfe, 0xff, 0xfe, 0xff, 0xff, 0xff, 0xff, 0xff, 0xfe, 0xff, 0xff, 0xff, 0xfd, 0xfd, 0xfd, 0xfc, 0xfc, 0xfc, 0xff, 0xff, 0xff, 0xff, 0xfe, 0xfe, 0xfd, 0xfd, 0xfc, 0xc4, 0xc5, 0xc4, 0x8a, 0x8b, 0x8b, 0x90, 0x90, 0x91, 0xa0, 0xa0, 0xa0, 0x98, 0x98, 0x98, 0x90, 0x90, 0x90, 0x94, 0x95, 0x94, 0xa0, 0xa0, 0xa0, 0x8d, 0x8d, 0x8d, 0xbb, 0xba, 0xbb, 0xf9, 0xf8, 0xf8, 0xff, 0xff, 0xff, 0xff, 0xfe, 0xff, 0xfa, 0xfa, 0xfa, 0xff, 0xff, 0xff, 0xff, 0xfe, 0xff, 0xff, 0xff, 0xff, 0xff, 0xff, 0xff, 0xff, 0xff, 0xff, 0xff, 0xff, 0xff, 
  0xff, 0xff, 0xff, 0xfd, 0xfc, 0xfd, 0xfa, 0xfb, 0xfb, 0xff, 0xff, 0xff, 0xff, 0xff, 0xff, 0xfe, 0xfe, 0xfe, 0xff, 0xff, 0xff, 0xff, 0xff, 0xff, 0xf8, 0xf8, 0xf8, 0xff, 0xff, 0xff, 0xf6, 0xf6, 0xf6, 0xbf, 0xbf, 0xbf, 0x99, 0x99, 0x98, 0x91, 0x91, 0x91, 0x94, 0x94, 0x94, 0x95, 0x95, 0x95, 0x98, 0x98, 0x98, 0x8a, 0x8a, 0x8a, 0xaf, 0xaf, 0xaf, 0xf4, 0xf5, 0xf4, 0xff, 0xff, 0xff, 0xf8, 0xf8, 0xf8, 0xff, 0xff, 0xff, 0xff, 0xff, 0xff, 0xff, 0xff, 0xff, 0xff, 0xff, 0xff, 0xff, 0xff, 0xff, 0xff, 0xff, 0xff, 0xff, 0xfe, 0xff, 0xff, 0xff, 0xff, 
  0xfe, 0xfe, 0xfe, 0xfc, 0xfd, 0xfc, 0xfb, 0xfb, 0xfb, 0xfd, 0xfd, 0xfc, 0xfd, 0xfd, 0xfd, 0xfe, 0xfe, 0xfe, 0xff, 0xff, 0xfe, 0xff, 0xfe, 0xff, 0xfe, 0xff, 0xff, 0xf3, 0xf3, 0xf3, 0xff, 0xff, 0xff, 0xff, 0xff, 0xff, 0xc1, 0xc1, 0xc1, 0x96, 0x96, 0x96, 0x97, 0x97, 0x97, 0x98, 0x98, 0x98, 0x9b, 0x9b, 0x9b, 0xa0, 0xa0, 0xa0, 0xeb, 0xeb, 0xeb, 0xff, 0xff, 0xff, 0xf8, 0xf8, 0xf8, 0xff, 0xff, 0xfe, 0xf8, 0xf8, 0xf8, 0xff, 0xff, 0xff, 0xff, 0xff, 0xff, 0xff, 0xff, 0xff, 0xff, 0xff, 0xff, 0xff, 0xff, 0xff, 0xff, 0xff, 0xff, 0xfe, 0xff, 0xff, 
  0xfc, 0xfc, 0xfc, 0xff, 0xff, 0xff, 0xff, 0xff, 0xff, 0xff, 0xff, 0xfe, 0xff, 0xff, 0xff, 0xfe, 0xfe, 0xfe, 0xfd, 0xfd, 0xfc, 0xfc, 0xfd, 0xfc, 0xff, 0xfe, 0xfe, 0xff, 0xff, 0xff, 0xff, 0xff, 0xff, 0xff, 0xff, 0xff, 0xf2, 0xf2, 0xf2, 0xbe, 0xbf, 0xbe, 0x96, 0x96, 0x96, 0x97, 0x97, 0x97, 0x94, 0x94, 0x94, 0xef, 0xee, 0xee, 0xff, 0xff, 0xff, 0xfa, 0xfa, 0xfa, 0xfd, 0xfd, 0xfd, 0xff, 0xff, 0xff, 0xff, 0xff, 0xff, 0xf7, 0xf7, 0xf7, 0xff, 0xff, 0xff, 0xff, 0xff, 0xff, 0xff, 0xff, 0xff, 0xff, 0xff, 0xff, 0xff, 0xff, 0xff, 0xff, 0xff, 0xff, 
  0xff, 0xff, 0xff, 0xff, 0xfe, 0xff, 0xfe, 0xff, 0xff, 0xff, 0xff, 0xfe, 0xff, 0xfe, 0xff, 0xff, 0xff, 0xff, 0xff, 0xff, 0xfe, 0xff, 0xfe, 0xff, 0xff, 0xff, 0xff, 0xff, 0xff, 0xfe, 0xfe, 0xff, 0xfe, 0xff, 0xff, 0xff, 0xff, 0xff, 0xff, 0xf1, 0xf1, 0xf1, 0xc2, 0xc3, 0xc3, 0x97, 0x97, 0x96, 0xe7, 0xe7, 0xe7, 0xf4, 0xf4, 0xf4, 0xff, 0xff, 0xff, 0xff, 0xff, 0xff, 0xfc, 0xfd, 0xfd, 0xff, 0xff, 0xff, 0xff, 0xff, 0xff, 0xff, 0xff, 0xff, 0xff, 0xff, 0xff, 0xff, 0xff, 0xff, 0xff, 0xff, 0xff, 0xff, 0xff, 0xff, 0xff, 0xff, 0xff, 0xff, 0xff, 0xff, 
  0xff, 0xff, 0xff, 0xff, 0xff, 0xff, 0xfe, 0xff, 0xff, 0xff, 0xff, 0xff, 0xff, 0xff, 0xff, 0xff, 0xff, 0xff, 0xff, 0xff, 0xfe, 0xff, 0xff, 0xff, 0xfe, 0xfe, 0xfe, 0xfe, 0xfe, 0xfe, 0xfd, 0xfc, 0xfd, 0xfe, 0xfe, 0xfe, 0xff, 0xff, 0xfe, 0xff, 0xff, 0xff, 0xf2, 0xf2, 0xf2, 0xdb, 0xdb, 0xdb, 0xf6, 0xf7, 0xf6, 0xfe, 0xfe, 0xfe, 0xff, 0xff, 0xff, 0xff, 0xfe, 0xff, 0xfe, 0xfe, 0xfe, 0xff, 0xff, 0xff, 0xff, 0xff, 0xff, 0xff, 0xff, 0xff, 0xff, 0xff, 0xff, 0xff, 0xff, 0xff, 0xff, 0xff, 0xff, 0xff, 0xff, 0xff, 0xff, 0xff, 0xff, 0xff, 0xff, 0xff, 
  0xff, 0xff, 0xff, 0xff, 0xff, 0xff, 0xff, 0xff, 0xff, 0xff, 0xff, 0xfe, 0xff, 0xff, 0xff, 0xff, 0xff, 0xff, 0xff, 0xff, 0xfe, 0xff, 0xff, 0xff, 0xfe, 0xfe, 0xfe, 0xff, 0xff, 0xfe, 0xfe, 0xfe, 0xfe, 0xfa, 0xfb, 0xfb, 0xfe, 0xfe, 0xff, 0xff, 0xfe, 0xff, 0xff, 0xff, 0xff, 0xff, 0xff, 0xff, 0xff, 0xfe, 0xff, 0xff, 0xff, 0xff, 0xff, 0xff, 0xff, 0xff, 0xff, 0xff, 0xff, 0xfe, 0xfe, 0xff, 0xff, 0xff, 0xff, 0xff, 0xff, 0xfe, 0xff, 0xff, 0xff, 0xff, 0xff, 0xff, 0xff, 0xff, 0xfe, 0xff, 0xff, 0xff, 0xff, 0xff, 0xff, 0xff, 0xff, 0xfe, 0xff, 0xff, 
  0xff, 0xff, 0xff, 0xff, 0xff, 0xff, 0xff, 0xff, 0xff, 0xff, 0xff, 0xff, 0xff, 0xff, 0xff, 0xff, 0xff, 0xff, 0xff, 0xff, 0xfe, 0xff, 0xff, 0xff, 0xfe, 0xfe, 0xfe, 0xff, 0xff, 0xff, 0xff, 0xff, 0xff, 0xfc, 0xfc, 0xfc, 0xf9, 0xf9, 0xf9, 0xfc, 0xfc, 0xfc, 0xfe, 0xfe, 0xfe, 0xfd, 0xfd, 0xfc, 0xff, 0xff, 0xff, 0xfe, 0xff, 0xff, 0xfe, 0xfe, 0xfe, 0xfd, 0xfd, 0xfd, 0xfe, 0xfe, 0xfe, 0xff, 0xff, 0xff, 0xff, 0xff, 0xff, 0xff, 0xff, 0xff, 0xff, 0xff, 0xff, 0xff, 0xfe, 0xff, 0xff, 0xff, 0xff, 0xff, 0xff, 0xfe, 0xff, 0xfe, 0xff, 0xff, 0xff, 0xff, 
  0xff, 0xff, 0xff, 0xff, 0xff, 0xff, 0xff, 0xff, 0xff, 0xff, 0xff, 0xfe, 0xff, 0xfe, 0xff, 0xfe, 0xff, 0xff, 0xff, 0xff, 0xff, 0xff, 0xff, 0xff, 0xfc, 0xfc, 0xfc, 0xff, 0xff, 0xff, 0xff, 0xff, 0xff, 0xfe, 0xff, 0xff, 0xff, 0xff, 0xff, 0xfe, 0xff, 0xfe, 0xfd, 0xfd, 0xfd, 0xfa, 0xfa, 0xfa, 0xff, 0xff, 0xff, 0xfd, 0xfd, 0xfd, 0xfc, 0xfc, 0xfc, 0xfe, 0xfe, 0xfe, 0xff, 0xff, 0xff, 0xff, 0xff, 0xfe, 0xff, 0xfe, 0xff, 0xfe, 0xfe, 0xfe, 0xff, 0xff, 0xff, 0xff, 0xff, 0xff, 0xff, 0xff, 0xff, 0xff, 0xff, 0xff, 0xff, 0xff, 0xff, 0xff, 0xff, 0xff, 
  0xff, 0xff, 0xff, 0xff, 0xff, 0xff, 0xfe, 0xff, 0xff, 0xff, 0xff, 0xff, 0xff, 0xff, 0xff, 0xfe, 0xff, 0xff, 0xff, 0xff, 0xff, 0xff, 0xff, 0xff, 0xff, 0xff, 0xff, 0xff, 0xff, 0xff, 0xff, 0xff, 0xff, 0xff, 0xff, 0xff, 0xff, 0xff, 0xfe, 0xff, 0xff, 0xff, 0xff, 0xff, 0xff, 0xff, 0xff, 0xff, 0xff, 0xff, 0xff, 0xfe, 0xfe, 0xfe, 0xff, 0xff, 0xfe, 0xff, 0xff, 0xff, 0xff, 0xff, 0xff, 0xff, 0xff, 0xfe, 0xfd, 0xfd, 0xfd, 0xfc, 0xfd, 0xfd, 0xff, 0xff, 0xff, 0xff, 0xff, 0xff, 0xfe, 0xff, 0xff, 0xff, 0xff, 0xff, 0xff, 0xff, 0xff, 0xff, 0xff, 0xff, 
};

const lv_image_dsc_t GreyHeartRune = {
  .header.cf = LV_COLOR_FORMAT_RGB888,
  .header.magic = LV_IMAGE_HEADER_MAGIC,
  .header.w = 30,
  .header.h = 30,
  .data_size = 900 * 3,
  .data = GreyHeartRune_map,
};
```

## src/HeartRune.c
```c
#ifdef __has_include
    #if __has_include("lvgl.h")
        #ifndef LV_LVGL_H_INCLUDE_SIMPLE
            #define LV_LVGL_H_INCLUDE_SIMPLE
        #endif
    #endif
#endif

#if defined(LV_LVGL_H_INCLUDE_SIMPLE)
    #include "lvgl.h"
#else
    #include "lvgl/lvgl.h"
#endif


#ifndef LV_ATTRIBUTE_MEM_ALIGN
#define LV_ATTRIBUTE_MEM_ALIGN
#endif

#ifndef LV_ATTRIBUTE_IMAGE_HEARTRUNE
#define LV_ATTRIBUTE_IMAGE_HEARTRUNE
#endif

const LV_ATTRIBUTE_MEM_ALIGN LV_ATTRIBUTE_LARGE_CONST LV_ATTRIBUTE_IMAGE_HEARTRUNE uint8_t HeartRune_map[] = {
  0xff, 0xf2, 0xff, 0xff, 0xf3, 0xff, 0xfe, 0xf8, 0xff, 0xf4, 0xf5, 0xff, 0xf4, 0xff, 0xff, 0xf3, 0xff, 0xff, 0xf3, 0xff, 0xf8, 0xfb, 0xff, 0xf8, 0xff, 0xff, 0xf8, 0xff, 0xfe, 0xf6, 0xff, 0xfe, 0xfb, 0xfe, 0xfd, 0xfc, 0xfe, 0xf7, 0xf8, 0xff, 0xfe, 0xff, 0xf8, 0xff, 0xff, 0xf6, 0xfe, 0xfe, 0xfc, 0xff, 0xff, 0xf4, 0xf5, 0xf5, 0xfc, 0xff, 0xff, 0xfb, 0xfd, 0xff, 0xf5, 0xf5, 0xff, 0xf4, 0xf2, 0xff, 0xfe, 0xfc, 0xff, 0xff, 0xff, 0xfb, 0xff, 0xff, 0xea, 0xfa, 0xff, 0xd7, 0xff, 0xff, 0xe6, 0xff, 0xff, 0xef, 0xfc, 0xfb, 0xf8, 0xff, 0xfc, 0xff, 
  0xff, 0xf5, 0xff, 0xff, 0xf8, 0xff, 0xfe, 0xf9, 0xff, 0xfb, 0xfe, 0xff, 0xe7, 0xf1, 0xf1, 0xf4, 0xff, 0xfe, 0xf6, 0xff, 0xfd, 0xf6, 0xfd, 0xfa, 0xfb, 0xfb, 0xfb, 0xff, 0xfd, 0xff, 0xff, 0xf7, 0xfd, 0xff, 0xfc, 0xff, 0xff, 0xfd, 0xff, 0xf8, 0xfa, 0xfe, 0xf8, 0xff, 0xff, 0xed, 0xf5, 0xf7, 0xfb, 0xfe, 0xff, 0xfb, 0xfe, 0xff, 0xf6, 0xf9, 0xff, 0xef, 0xf2, 0xff, 0xf7, 0xfa, 0xff, 0xf8, 0xfb, 0xff, 0xf2, 0xf5, 0xfa, 0xf8, 0xfc, 0xf6, 0xfe, 0xff, 0xed, 0xff, 0xfe, 0xee, 0xf9, 0xf9, 0xe5, 0xff, 0xff, 0xf5, 0xff, 0xfd, 0xfd, 0xff, 0xfd, 0xff, 
  0xff, 0xff, 0xfa, 0xff, 0xfe, 0xfa, 0xf3, 0xf6, 0xed, 0xfc, 0xff, 0xf9, 0xfa, 0xfe, 0xfa, 0xf8, 0xff, 0xfd, 0xed, 0xf6, 0xf8, 0xf5, 0xfd, 0xff, 0xf5, 0xfa, 0xff, 0xd1, 0xd4, 0xed, 0xce, 0xd1, 0xea, 0xdf, 0xe2, 0xf8, 0xeb, 0xf0, 0xff, 0xf3, 0xfa, 0xff, 0xf8, 0xff, 0xff, 0xf8, 0xff, 0xff, 0xea, 0xf0, 0xf7, 0xee, 0xf4, 0xff, 0xe6, 0xe9, 0xfe, 0xd0, 0xd4, 0xf4, 0xcd, 0xd5, 0xec, 0xe9, 0xf4, 0xff, 0xf4, 0xff, 0xfe, 0xf8, 0xff, 0xfb, 0xf2, 0xf4, 0xf6, 0xff, 0xfd, 0xff, 0xfe, 0xf6, 0xff, 0xff, 0xfb, 0xff, 0xff, 0xfd, 0xff, 0xff, 0xfd, 0xff, 
  0xfa, 0xff, 0xf5, 0xfa, 0xff, 0xf4, 0xf9, 0xff, 0xf0, 0xfc, 0xff, 0xf5, 0xfc, 0xff, 0xf8, 0xf0, 0xf7, 0xf7, 0xe9, 0xf0, 0xff, 0x7b, 0x82, 0xa4, 0x1b, 0x20, 0x54, 0x18, 0x1f, 0x5d, 0x18, 0x20, 0x5f, 0x07, 0x0f, 0x47, 0x3e, 0x47, 0x6e, 0xb2, 0xbc, 0xd1, 0xe9, 0xf1, 0xf5, 0xe5, 0xed, 0xf3, 0xb5, 0xbc, 0xd3, 0x44, 0x49, 0x72, 0x11, 0x13, 0x4c, 0x1f, 0x22, 0x5f, 0x0d, 0x16, 0x46, 0x12, 0x1f, 0x3f, 0x79, 0x89, 0x97, 0xef, 0xfc, 0xff, 0xf7, 0xfa, 0xff, 0xf1, 0xee, 0xff, 0xff, 0xf8, 0xff, 0xfe, 0xf8, 0xff, 0xff, 0xfe, 0xff, 0xfe, 0xff, 0xfd, 
  0xf6, 0xff, 0xff, 0xe8, 0xf3, 0xee, 0xfa, 0xff, 0xf8, 0xfc, 0xff, 0xf9, 0xf0, 0xf5, 0xf0, 0xe3, 0xe8, 0xf4, 0x3c, 0x40, 0x69, 0x30, 0x34, 0x7b, 0x48, 0x4d, 0xb3, 0x51, 0x57, 0xcf, 0x3d, 0x45, 0xbe, 0x54, 0x5c, 0xc9, 0x40, 0x49, 0x9a, 0x22, 0x2d, 0x5f, 0x57, 0x60, 0x75, 0x5e, 0x65, 0x7b, 0x18, 0x1b, 0x52, 0x4b, 0x4b, 0x9b, 0x59, 0x59, 0xb6, 0x4e, 0x4e, 0xb1, 0x55, 0x59, 0xb8, 0x50, 0x57, 0xaa, 0x34, 0x3f, 0x7b, 0x26, 0x31, 0x5b, 0xd3, 0xdc, 0xf6, 0xf5, 0xfc, 0xff, 0xfb, 0xfd, 0xff, 0xf5, 0xf7, 0xf5, 0xfd, 0xff, 0xf6, 0xff, 0xff, 0xf6, 
  0xf1, 0xff, 0xf9, 0xf6, 0xfe, 0xfd, 0xf7, 0xfe, 0xfb, 0xf0, 0xf5, 0xfa, 0xee, 0xee, 0xff, 0x36, 0x36, 0x62, 0x29, 0x29, 0x75, 0x47, 0x4a, 0xb3, 0x50, 0x57, 0xdc, 0x21, 0x2b, 0xbe, 0x4a, 0x57, 0xe9, 0x42, 0x50, 0xd5, 0x3d, 0x48, 0xb3, 0x39, 0x43, 0x92, 0x00, 0x01, 0x36, 0x00, 0x05, 0x3a, 0x33, 0x36, 0x88, 0x4d, 0x50, 0xb5, 0x57, 0x5b, 0xc8, 0x4a, 0x4f, 0xc3, 0x47, 0x4c, 0xc6, 0x4c, 0x52, 0xc6, 0x45, 0x4d, 0xae, 0x3b, 0x45, 0x8d, 0x4c, 0x59, 0x81, 0xe3, 0xf0, 0xff, 0xf5, 0xfe, 0xff, 0xfc, 0xff, 0xfb, 0xfa, 0xfe, 0xf3, 0xff, 0xff, 0xf6, 
  0xf1, 0xff, 0xe6, 0xf8, 0xfe, 0xf6, 0xed, 0xf1, 0xf9, 0xf5, 0xf4, 0xfe, 0x3b, 0x35, 0x79, 0x35, 0x2d, 0x8e, 0x5c, 0x57, 0xd0, 0x52, 0x55, 0xde, 0x3b, 0x47, 0xd8, 0x41, 0x54, 0xe5, 0x25, 0x3c, 0xc7, 0x3c, 0x52, 0xd3, 0x22, 0x33, 0xa9, 0x00, 0x09, 0x74, 0x42, 0x44, 0xa9, 0x56, 0x58, 0xba, 0x16, 0x1d, 0x84, 0x00, 0x08, 0x72, 0x18, 0x27, 0x92, 0x42, 0x51, 0xc4, 0x3f, 0x4b, 0xce, 0x3e, 0x47, 0xcd, 0x4b, 0x52, 0xd0, 0x4c, 0x55, 0xb9, 0x0f, 0x1c, 0x57, 0x80, 0x8f, 0xaa, 0xf1, 0xfd, 0xff, 0xfa, 0xff, 0xfd, 0xfa, 0xfb, 0xf9, 0xfd, 0xf9, 0xf8, 
  0xfe, 0xff, 0xe5, 0xfb, 0xff, 0xf1, 0xef, 0xf4, 0xff, 0x99, 0x98, 0xca, 0x24, 0x1e, 0x7a, 0x53, 0x4e, 0xc8, 0x40, 0x40, 0xcd, 0x39, 0x41, 0xd4, 0x31, 0x43, 0xd2, 0x37, 0x50, 0xd8, 0x2f, 0x4c, 0xc9, 0x01, 0x10, 0x89, 0x00, 0x0b, 0x84, 0x3e, 0x4c, 0xc7, 0x50, 0x56, 0xd7, 0x3c, 0x41, 0xc2, 0x46, 0x50, 0xcb, 0x30, 0x40, 0xb5, 0x03, 0x18, 0x88, 0x00, 0x0c, 0x80, 0x1e, 0x32, 0xb1, 0x41, 0x52, 0xd7, 0x42, 0x4e, 0xd2, 0x3f, 0x49, 0xbc, 0x4f, 0x59, 0xaa, 0x1e, 0x28, 0x5a, 0xe9, 0xf1, 0xff, 0xf1, 0xf7, 0xfa, 0xfa, 0xfa, 0xf9, 0xfe, 0xff, 0xfd, 
  0xff, 0xff, 0xe2, 0xfa, 0xfe, 0xe8, 0xf3, 0xf8, 0xff, 0x48, 0x4c, 0x7f, 0x47, 0x4a, 0xa7, 0x4b, 0x51, 0xc9, 0x36, 0x42, 0xc8, 0x35, 0x47, 0xcf, 0x3d, 0x56, 0xd4, 0x1c, 0x39, 0xae, 0x00, 0x12, 0x7e, 0x05, 0x21, 0x8d, 0x39, 0x52, 0xc7, 0x3e, 0x52, 0xd1, 0x30, 0x40, 0xcc, 0x41, 0x4f, 0xe0, 0x3b, 0x49, 0xd7, 0x2e, 0x40, 0xc7, 0x43, 0x5a, 0xd8, 0x2a, 0x46, 0xbc, 0x00, 0x00, 0x69, 0x00, 0x1c, 0x8c, 0x33, 0x47, 0xbe, 0x41, 0x4c, 0xc2, 0x52, 0x55, 0xc1, 0x13, 0x12, 0x66, 0xb9, 0xba, 0xe5, 0xf9, 0xfb, 0xff, 0xfe, 0xfe, 0xf8, 0xff, 0xff, 0xf0, 
  0xff, 0xff, 0xed, 0xff, 0xff, 0xf6, 0xf6, 0xf8, 0xff, 0x2e, 0x36, 0x64, 0x42, 0x4f, 0xa0, 0x48, 0x5b, 0xc3, 0x39, 0x50, 0xc7, 0x43, 0x5d, 0xd7, 0x1a, 0x33, 0xab, 0x00, 0x04, 0x78, 0x14, 0x2d, 0x9d, 0x4a, 0x63, 0xd5, 0x32, 0x4a, 0xc5, 0x2a, 0x42, 0xc7, 0x3a, 0x53, 0xe3, 0x29, 0x40, 0xd9, 0x30, 0x42, 0xdd, 0x3b, 0x4c, 0xe3, 0x24, 0x3b, 0xc5, 0x2c, 0x48, 0xc6, 0x3d, 0x5f, 0xcd, 0x12, 0x31, 0x9c, 0x00, 0x00, 0x6f, 0x14, 0x1e, 0x93, 0x47, 0x47, 0xb9, 0x4c, 0x47, 0xa2, 0x6b, 0x6a, 0x98, 0xfa, 0xfc, 0xff, 0xff, 0xff, 0xf5, 0xff, 0xff, 0xec, 
  0xff, 0xfa, 0xff, 0xff, 0xf7, 0xff, 0xf8, 0xf7, 0xff, 0x53, 0x5d, 0x85, 0x3b, 0x51, 0x8b, 0x3b, 0x59, 0xa4, 0x3a, 0x58, 0xb6, 0x00, 0x19, 0x87, 0x00, 0x0b, 0x87, 0x35, 0x44, 0xc8, 0x41, 0x4d, 0xd8, 0x31, 0x3e, 0xcc, 0x3d, 0x50, 0xdc, 0x38, 0x51, 0xde, 0x22, 0x43, 0xce, 0x2b, 0x4b, 0xde, 0x34, 0x46, 0xeb, 0x31, 0x41, 0xe5, 0x35, 0x4b, 0xdf, 0x2f, 0x4a, 0xd0, 0x2c, 0x4a, 0xc4, 0x40, 0x59, 0xcf, 0x46, 0x56, 0xcf, 0x15, 0x1c, 0x90, 0x00, 0x00, 0x60, 0x22, 0x20, 0x68, 0x92, 0x95, 0xb1, 0xfb, 0xff, 0xfc, 0xfc, 0xff, 0xee, 0xfc, 0xff, 0xe6, 
  0xff, 0xf2, 0xfe, 0xff, 0xf6, 0xff, 0xf9, 0xf5, 0xff, 0x9e, 0xa6, 0xca, 0x1a, 0x30, 0x5e, 0x45, 0x61, 0xa0, 0x00, 0x14, 0x68, 0x05, 0x1c, 0x85, 0x35, 0x43, 0xc1, 0x41, 0x4a, 0xd9, 0x42, 0x49, 0xe1, 0x3b, 0x43, 0xe0, 0x36, 0x46, 0xe0, 0x2a, 0x42, 0xd8, 0x23, 0x44, 0xd3, 0x2e, 0x4f, 0xe1, 0x2c, 0x43, 0xe2, 0x2e, 0x43, 0xe2, 0x35, 0x4e, 0xde, 0x32, 0x4c, 0xd2, 0x37, 0x4f, 0xd0, 0x33, 0x46, 0xc2, 0x50, 0x5b, 0xd4, 0x4a, 0x4f, 0xb8, 0x4b, 0x4e, 0x9b, 0x00, 0x00, 0x2d, 0xba, 0xbf, 0xcc, 0xfc, 0xff, 0xfb, 0xff, 0xfe, 0xf7, 0xff, 0xff, 0xf4, 
  0xff, 0xfa, 0xff, 0xff, 0xf9, 0xff, 0xf5, 0xf2, 0xff, 0xe5, 0xea, 0xff, 0x38, 0x43, 0x73, 0x01, 0x07, 0x49, 0x2f, 0x3d, 0x94, 0x45, 0x53, 0xbf, 0x4e, 0x57, 0xd9, 0x30, 0x37, 0xc9, 0x3b, 0x42, 0xde, 0x45, 0x4f, 0xf0, 0x2d, 0x3b, 0xdd, 0x2c, 0x40, 0xdf, 0x34, 0x4f, 0xe9, 0x23, 0x40, 0xd5, 0x2a, 0x47, 0xd5, 0x33, 0x4f, 0xd6, 0x2d, 0x4b, 0xcb, 0x2a, 0x44, 0xc4, 0x47, 0x5a, 0xde, 0x35, 0x42, 0xc3, 0x3d, 0x44, 0xb8, 0x52, 0x57, 0xaf, 0x1c, 0x23, 0x51, 0xb1, 0xb8, 0xca, 0xfa, 0xff, 0xff, 0xfa, 0xfb, 0xfa, 0xee, 0xea, 0xf6, 0xfe, 0xf8, 0xff, 
  0xff, 0xff, 0xfe, 0xf7, 0xf7, 0xf8, 0xf5, 0xf7, 0xfe, 0xf6, 0xfa, 0xff, 0xaa, 0xaf, 0xd0, 0x0c, 0x12, 0x47, 0x4a, 0x51, 0x9f, 0x51, 0x58, 0xbe, 0x39, 0x40, 0xbf, 0x4b, 0x53, 0xe5, 0x3c, 0x47, 0xe5, 0x29, 0x37, 0xda, 0x36, 0x47, 0xe8, 0x37, 0x4d, 0xe8, 0x2c, 0x43, 0xd8, 0x2e, 0x49, 0xd6, 0x30, 0x4e, 0xd5, 0x29, 0x47, 0xcb, 0x3c, 0x57, 0xdc, 0x2b, 0x41, 0xc9, 0x2f, 0x3e, 0xc7, 0x55, 0x5f, 0xdb, 0x51, 0x59, 0xba, 0x1f, 0x27, 0x66, 0x78, 0x81, 0x99, 0xe1, 0xe9, 0xeb, 0xf5, 0xf6, 0xf7, 0xff, 0xfd, 0xff, 0xff, 0xf9, 0xff, 0xfc, 0xf5, 0xff, 
  0xf1, 0xff, 0xec, 0xf9, 0xff, 0xf3, 0xfb, 0xff, 0xf3, 0xfb, 0xff, 0xf8, 0xf8, 0xfd, 0xff, 0xc9, 0xcd, 0xe4, 0x1f, 0x23, 0x58, 0x44, 0x48, 0x9e, 0x4f, 0x56, 0xcd, 0x37, 0x42, 0xd2, 0x32, 0x40, 0xe0, 0x39, 0x4b, 0xee, 0x34, 0x49, 0xe2, 0x28, 0x3f, 0xcd, 0x31, 0x49, 0xc8, 0x3f, 0x59, 0xd7, 0x2d, 0x48, 0xd2, 0x2b, 0x42, 0xda, 0x36, 0x46, 0xec, 0x38, 0x43, 0xe7, 0x48, 0x52, 0xe2, 0x3f, 0x49, 0xb8, 0x18, 0x25, 0x67, 0x53, 0x5f, 0x7f, 0xf2, 0xfa, 0xff, 0xfc, 0xfe, 0xff, 0xff, 0xfb, 0xff, 0xef, 0xe8, 0xf3, 0xff, 0xfd, 0xff, 0xff, 0xfd, 0xff, 
  0xf7, 0xff, 0xf4, 0xf2, 0xff, 0xec, 0xfc, 0xff, 0xf0, 0xfa, 0xff, 0xed, 0xff, 0xff, 0xf6, 0xfc, 0xfe, 0xff, 0xb5, 0xb7, 0xd6, 0x17, 0x1b, 0x59, 0x43, 0x49, 0xa9, 0x43, 0x4d, 0xc9, 0x40, 0x4e, 0xdd, 0x32, 0x44, 0xdb, 0x2e, 0x44, 0xd6, 0x38, 0x50, 0xdb, 0x3c, 0x54, 0xd5, 0x2f, 0x48, 0xcb, 0x33, 0x4b, 0xdd, 0x31, 0x44, 0xe3, 0x36, 0x40, 0xe9, 0x3a, 0x3f, 0xdd, 0x45, 0x4a, 0xc8, 0x30, 0x36, 0x8e, 0x35, 0x3e, 0x68, 0xf4, 0xfc, 0xff, 0xf9, 0xfc, 0xff, 0xfb, 0xf8, 0xfc, 0xff, 0xf9, 0xff, 0xff, 0xfb, 0xff, 0xfd, 0xfb, 0xfe, 0xf8, 0xfa, 0xf8, 
  0xf8, 0xfa, 0xfe, 0xfd, 0xff, 0xff, 0xff, 0xff, 0xfb, 0xfe, 0xff, 0xf7, 0xff, 0xfe, 0xf8, 0xff, 0xff, 0xfe, 0xee, 0xee, 0xfb, 0xcc, 0xcd, 0xef, 0x11, 0x12, 0x4e, 0x5b, 0x5f, 0xb4, 0x40, 0x48, 0xb6, 0x35, 0x41, 0xc1, 0x3f, 0x4f, 0xda, 0x37, 0x4b, 0xdf, 0x2f, 0x46, 0xde, 0x34, 0x4b, 0xe6, 0x2f, 0x43, 0xe4, 0x39, 0x48, 0xe4, 0x37, 0x41, 0xce, 0x4b, 0x4f, 0xc5, 0x3f, 0x3f, 0x93, 0x2a, 0x28, 0x5d, 0xf0, 0xed, 0xff, 0xff, 0xfc, 0xff, 0xff, 0xfe, 0xff, 0xff, 0xfe, 0xfe, 0xff, 0xfd, 0xff, 0xff, 0xfd, 0xfe, 0xff, 0xff, 0xff, 0xfe, 0xff, 0xff, 
  0xfd, 0xfa, 0xff, 0xff, 0xfd, 0xff, 0xfe, 0xff, 0xff, 0xfc, 0xfb, 0xf7, 0xff, 0xfd, 0xf8, 0xff, 0xff, 0xfd, 0xfe, 0xfd, 0xff, 0xed, 0xed, 0xfe, 0xbe, 0xc0, 0xe3, 0x0e, 0x11, 0x4a, 0x47, 0x4d, 0x9f, 0x57, 0x61, 0xca, 0x43, 0x52, 0xd1, 0x2d, 0x3f, 0xcf, 0x25, 0x3b, 0xd7, 0x2c, 0x41, 0xe2, 0x35, 0x46, 0xe3, 0x32, 0x40, 0xce, 0x4b, 0x55, 0xca, 0x4a, 0x4f, 0xa7, 0x25, 0x25, 0x5d, 0xe4, 0xdf, 0xfe, 0xef, 0xe7, 0xf2, 0xfe, 0xfd, 0xff, 0xff, 0xfe, 0xfd, 0xff, 0xff, 0xfd, 0xff, 0xfe, 0xff, 0xff, 0xfe, 0xff, 0xff, 0xff, 0xff, 0xfd, 0xff, 0xff, 
  0xfc, 0xfe, 0xfa, 0xfe, 0xfe, 0xfd, 0xff, 0xff, 0xfd, 0xfe, 0xfd, 0xfb, 0xfe, 0xfa, 0xfa, 0xff, 0xfe, 0xff, 0xff, 0xfd, 0xff, 0xfc, 0xfa, 0xff, 0xf7, 0xf8, 0xff, 0xb5, 0xbb, 0xe2, 0x0e, 0x17, 0x53, 0x40, 0x4d, 0x9f, 0x43, 0x53, 0xbd, 0x3e, 0x4f, 0xce, 0x3e, 0x50, 0xe0, 0x3b, 0x4d, 0xe0, 0x36, 0x47, 0xcd, 0x47, 0x56, 0xcb, 0x3d, 0x48, 0xa6, 0x15, 0x1c, 0x61, 0xc1, 0xc2, 0xeb, 0xfa, 0xf8, 0xff, 0xff, 0xfc, 0xff, 0xff, 0xf9, 0xf4, 0xff, 0xff, 0xfb, 0xff, 0xff, 0xfd, 0xff, 0xfe, 0xff, 0xff, 0xfd, 0xff, 0xfe, 0xfe, 0xff, 0xfd, 0xfe, 0xff, 
  0xfa, 0xff, 0xf4, 0xfc, 0xff, 0xf6, 0xfe, 0xff, 0xfb, 0xff, 0xff, 0xfe, 0xff, 0xff, 0xff, 0xff, 0xf9, 0xfe, 0xff, 0xfb, 0xff, 0xfd, 0xfd, 0xff, 0xf3, 0xf6, 0xff, 0xf2, 0xfa, 0xff, 0xb9, 0xc5, 0xe9, 0x0b, 0x18, 0x52, 0x3e, 0x4e, 0xa0, 0x44, 0x54, 0xbe, 0x37, 0x46, 0xc5, 0x34, 0x42, 0xc3, 0x40, 0x4e, 0xbc, 0x53, 0x61, 0xba, 0x02, 0x0d, 0x53, 0xa1, 0xa8, 0xd9, 0xef, 0xf3, 0xff, 0xfc, 0xfd, 0xff, 0xf9, 0xf8, 0xf4, 0xff, 0xff, 0xf8, 0xff, 0xff, 0xfa, 0xff, 0xff, 0xfd, 0xfe, 0xfe, 0xff, 0xff, 0xfd, 0xff, 0xfe, 0xfd, 0xff, 0xfd, 0xfe, 0xff, 
  0xfc, 0xff, 0xf2, 0xfb, 0xff, 0xf3, 0xfe, 0xff, 0xf9, 0xff, 0xff, 0xff, 0xff, 0xfd, 0xff, 0xfe, 0xf9, 0xff, 0xfd, 0xf8, 0xfc, 0xfd, 0xfa, 0xfd, 0xf9, 0xfd, 0xfb, 0xf5, 0xfe, 0xff, 0xef, 0xfc, 0xff, 0xb9, 0xc8, 0xe8, 0x0b, 0x19, 0x53, 0x3b, 0x49, 0x9a, 0x4a, 0x54, 0xbd, 0x53, 0x5d, 0xc4, 0x52, 0x5f, 0xae, 0x03, 0x10, 0x4a, 0x93, 0x9d, 0xc9, 0xf1, 0xf9, 0xff, 0xf3, 0xf8, 0xff, 0xf9, 0xfc, 0xf7, 0xff, 0xff, 0xf7, 0xfe, 0xff, 0xf2, 0xff, 0xff, 0xf9, 0xff, 0xff, 0xfd, 0xfe, 0xfe, 0xff, 0xfd, 0xfd, 0xff, 0xfd, 0xfd, 0xff, 0xfc, 0xfd, 0xff, 
  0xfb, 0xff, 0xf3, 0xfc, 0xff, 0xf5, 0xfb, 0xfe, 0xf8, 0xfe, 0xfc, 0xfe, 0xff, 0xfd, 0xff, 0xff, 0xfc, 0xff, 0xff, 0xfd, 0xff, 0xff, 0xff, 0xfd, 0xff, 0xff, 0xf9, 0xf9, 0xff, 0xf8, 0xf3, 0xfe, 0xfd, 0xed, 0xfb, 0xff, 0xb3, 0xbe, 0xe3, 0x16, 0x1f, 0x5b, 0x4c, 0x52, 0xa4, 0x4c, 0x52, 0xa3, 0x29, 0x32, 0x67, 0x61, 0x6b, 0x8d, 0xf2, 0xf9, 0xff, 0xf7, 0xfd, 0xff, 0xfc, 0xff, 0xfd, 0xf8, 0xfc, 0xf0, 0xff, 0xff, 0xf4, 0xfb, 0xfe, 0xef, 0xff, 0xff, 0xf9, 0xfd, 0xff, 0xfd, 0xfa, 0xff, 0xff, 0xfb, 0xfd, 0xfe, 0xfd, 0xfd, 0xff, 0xfd, 0xfd, 0xff, 
  0xfb, 0xff, 0xf6, 0xfc, 0xff, 0xf8, 0xfd, 0xff, 0xfb, 0xfd, 0xfb, 0xfd, 0xff, 0xfc, 0xff, 0xff, 0xfd, 0xff, 0xff, 0xff, 0xfe, 0xff, 0xff, 0xfa, 0xfd, 0xfe, 0xf1, 0xff, 0xff, 0xf6, 0xfa, 0xff, 0xf9, 0xf4, 0xfd, 0xff, 0xf2, 0xfa, 0xff, 0xba, 0xc0, 0xe7, 0x06, 0x09, 0x42, 0x34, 0x37, 0x6d, 0x57, 0x5b, 0x7a, 0xf6, 0xfb, 0xff, 0xea, 0xed, 0xf5, 0xfb, 0xfd, 0xfd, 0xfe, 0xff, 0xf8, 0xff, 0xff, 0xf5, 0xfe, 0xff, 0xf3, 0xfe, 0xff, 0xf7, 0xfc, 0xff, 0xfb, 0xfa, 0xfe, 0xfe, 0xf9, 0xff, 0xff, 0xfa, 0xfe, 0xff, 0xfc, 0xfd, 0xff, 0xfc, 0xfd, 0xff, 
  0xf5, 0xfb, 0xf6, 0xfc, 0xff, 0xfd, 0xfe, 0xff, 0xff, 0xff, 0xfe, 0xff, 0xff, 0xfd, 0xff, 0xff, 0xfe, 0xff, 0xff, 0xff, 0xfc, 0xff, 0xff, 0xf7, 0xff, 0xff, 0xf6, 0xff, 0xff, 0xf3, 0xfd, 0xff, 0xf7, 0xfd, 0xff, 0xfe, 0xf5, 0xf8, 0xff, 0xf2, 0xf5, 0xff, 0xd7, 0xd7, 0xfa, 0x4e, 0x4e, 0x6f, 0xf6, 0xf7, 0xff, 0xfd, 0xfc, 0xff, 0xfb, 0xfa, 0xfa, 0xff, 0xff, 0xfc, 0xff, 0xff, 0xf7, 0xfb, 0xfc, 0xef, 0xff, 0xfe, 0xf7, 0xfb, 0xff, 0xf6, 0xfb, 0xff, 0xfc, 0xf9, 0xff, 0xff, 0xf9, 0xff, 0xff, 0xf9, 0xfe, 0xff, 0xfc, 0xff, 0xff, 0xfd, 0xfe, 0xff, 
  0xfb, 0xfd, 0xff, 0xfc, 0xfd, 0xff, 0xfe, 0xfe, 0xff, 0xff, 0xfe, 0xfe, 0xff, 0xff, 0xfd, 0xff, 0xff, 0xfb, 0xff, 0xff, 0xf8, 0xff, 0xff, 0xf9, 0xff, 0xff, 0xf9, 0xff, 0xff, 0xfa, 0xff, 0xff, 0xfd, 0xff, 0xfe, 0xff, 0xfd, 0xfd, 0xfe, 0xfc, 0xfb, 0xff, 0xfa, 0xfa, 0xff, 0xfb, 0xfa, 0xff, 0xff, 0xfd, 0xff, 0xff, 0xfd, 0xff, 0xff, 0xfe, 0xfe, 0xff, 0xfe, 0xfe, 0xfe, 0xff, 0xfb, 0xff, 0xff, 0xfa, 0xff, 0xff, 0xfb, 0xfe, 0xff, 0xfd, 0xfa, 0xff, 0xff, 0xf8, 0xff, 0xff, 0xf7, 0xff, 0xff, 0xf8, 0xff, 0xff, 0xfc, 0xfe, 0xff, 0xfd, 0xff, 0xff, 
  0xfb, 0xfb, 0xfe, 0xfc, 0xfb, 0xff, 0xff, 0xfd, 0xff, 0xff, 0xfe, 0xff, 0xff, 0xfe, 0xfb, 0xfe, 0xff, 0xf9, 0xff, 0xff, 0xf8, 0xff, 0xfe, 0xf9, 0xff, 0xff, 0xfa, 0xff, 0xff, 0xfd, 0xff, 0xfe, 0xff, 0xff, 0xfd, 0xff, 0xff, 0xfd, 0xff, 0xff, 0xfd, 0xff, 0xfe, 0xfd, 0xff, 0xff, 0xfd, 0xfe, 0xff, 0xfd, 0xff, 0xff, 0xfd, 0xff, 0xff, 0xfd, 0xff, 0xff, 0xfe, 0xfe, 0xff, 0xff, 0xfd, 0xff, 0xff, 0xfd, 0xff, 0xff, 0xfd, 0xff, 0xff, 0xfe, 0xfa, 0xff, 0xfe, 0xf7, 0xff, 0xff, 0xf7, 0xff, 0xff, 0xf8, 0xff, 0xff, 0xfb, 0xff, 0xff, 0xfd, 0xff, 0xff, 
};

const lv_image_dsc_t HeartRune = {
  .header.cf = LV_COLOR_FORMAT_RGB888,
  .header.magic = LV_IMAGE_HEADER_MAGIC,
  .header.w = 30,
  .header.h = 26,
  .data_size = 780 * 3,
  .data = HeartRune_map,
};
```

## src/Reference.c
```c
/*-----------------HOW TO USE STUFF----------------------*/

/*---------If you want to make a button :)
    lv_obj_t *ui_btn = lv_button_create(screen);                                                        //Creates the button
    lv_obj_align(object you're setting(ui_bt), Anchor point(LV_ALIGN_CENTER), x_offset, y_offset));     //Determines where it is
    lv_obj_t *button_label = lv_label_create(ui_btn);                                                   //Creates a text label that is a child of the button
    char label_text[10];                                                                                //Create the name of the button
    snprintf(label_text, 10, "MESSAGE");                                                                //Print the label, number is max size of buffer
    lv_label_set_text(button_label, label_text);                                                        //Label the button
    lv_obj_align(button_label, LV_ALIGN_CENTER, 0,0);                                                   //Align the text on the button (what are the parameters)

    led_id led = (led_id)i;                                                                             //Data you want to pass into the callback
    lv_obj_t *data_obj = lv_data_obj_create_alloc_assign(ui_btn, &led, sizeof(led_id));                 //Safely attach that data to the button object
    lv_obj_add_event_cb(ui_btn, lv_button_callback, LV_EVENT_CLICKED, data_obj);                        //When this button is clicked call lv_button_callback and pass it data_obj

  display_blanking_off(display_dev);                                                                    //Display blank off so you can see stuff

/*---------If you want just text to appear :)
    lv_obj_t *label = lv_label_create(screen);                                                          //Create a label
    lv_label_set_text(label, "YOUR MESSAGE");                                                           //Set the text of the label
    display_blanking_off(display_dev);                                                                  //Display the message                                                                               
*/

/*---------If you want to move something :)
    lv_obj_align(label, LV_ALIGN_CENTER, 0, 0);                                                         // dead center
    lv_obj_align(label, LV_ALIGN_TOP_MID, 0, 20);                                                       // top center, 20px down
    lv_obj_align(label, LV_ALIGN_BOTTOM_MID, 0, -20);                                                   // bottom center, 20px up
*/


/*----------Update the screen :)
while(1) {
    lv_timer_handler();                                                                                 //lls LVGL to process any pending events and redraw anything that changed                                                              
    k_msleep(SLEEP_MS);                                                                                 // wait 100ms before doing it again - this is your tick rate
  }
  return 0;
*/

/*---------If you want to clear the screen :)
    lv_obj_clean(lv_screen_active()); //Clear the screen
*/

/*---------If you want to colour a button or text :)
lv_obj_set_style_bg_color(ui_btn, lv_color_hex(0xFF0000), LV_STATE_DEFAULT);  // red
lv_obj_set_style_bg_color(ui_btn, lv_color_hex(0x00FF00), LV_STATE_DEFAULT);  // green
lv_obj_set_style_bg_color(ui_btn, lv_color_hex(0x0000FF), LV_STATE_DEFAULT);  // blue

lv_obj_set_style_text_color(label, lv_color_hex(0xFFFFFF), LV_STATE_DEFAULT);  // white text

*/
```
